 #define LOG0
 #define LOG1
 #define LOG2
 #define LOG3

#ifndef SERIAL_RX_BUFFER_SIZE
#define SERIAL_RX_BUFFER_SIZE 64
#endif /* SERIAL_RX_BUFFER_SIZE */

// #define COMMON_ANODE

#define clRED     0xff0000
#define clGREEN   0x00ff00
#define clBLUE    0x0000ff
#define clCYAN    0x003a3a
#define clMAGENTA 0xff003a
#define clYELLOW  0xff3a00
#define clWHITE   0xaa5a5a
#define clORANGE  0xff3407
#define clPINK    0xff2240

#define CHECK_ROM

#define VERSION 0x100
#define CPLD_NAME "/SD81CPLD"
#define MAX_FILENAME_LEN 100

#define BUFFSIZE 512
#define MAX_FILE_ARRAY BUFFSIZE/2

#define GET_NEXT_CHAR 13

#define CMD_NOP       0
#define CMD_VER       1
#define CMD_DIR       2
#define CMD_CD        3
#define CMD_IDLE    255

#define END_BYTE    255

#define LED_OFF HIGH
#define LED_ON  LOW


uint8_t copy_buffer[BUFFSIZE];
char array_dirname[MAX_FILENAME_LEN];
uint16_t* file_array; //[MAX_FILE_ARRAY];
uint8_t sys_vars[128];
uint16_t row_array;

uint32_t sdtotal = 0;
bool sdled = false;
uint32_t clk_count = 0;
volatile bool clock = 0;
volatile uint8_t command_active = CMD_IDLE;
char params[MAX_FILENAME_LEN] = "";
char tmp[MAX_FILENAME_LEN]="";

//char last_file[MAX_FILENAME_LEN]="";
uint8_t file_counter = 0;

volatile uint8_t data_in = CMD_IDLE;
volatile bool data_ready = false;

volatile bool rst_ctrl_reg = HIGH;
volatile bool rst_data_reg = HIGH;
bool reseted = false;
bool initialised = false;

SdFile dir;
SdFile Sfile;
SdFile Dfile;
SdFile TmpFile;

const char asc_to_asc81 [] PROGMEM = {
  0x0f,0x0f,0x0f,0x0f,0x0f,0x0f,0x0f,0x0f,0x77,0x0f,0x76,0x0f,0x0f,0x76,0x0f,0x0f, //00..0f
  0x0f,0x0f,0x0f,0x0f,0x0f,0x0f,0x0f,0x0f,0x0f,0x0f,0x0f,0x0f,0x0f,0x0f,0x0f,0x0f, //10..1f
  0x00,0x0f,0x0b,0x0f,0x0d,0x0f,0x0f,0x0f,0x10,0x11,0x17,0x15,0x1a,0x16,0x1b,0x18, //20..2f
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  0x0f,0x0f,0x0f,0x0f,0x0f,0x0f,0x0f,0x0f,0x0f,0x0f,0x0f,0x0f,0x0f,0x0f,0x0f,0xff  //f0..ff
  };

  const char asc81_to_ascii [] PROGMEM = {
   ' ', '?', '?', '?', '?', '?', '?', '?', '?', '?', '?', '"', '&', '$', ':', '?', //00..0f
   '(', ')', '>', '<', '=', '+', '-', '*', '/', ';', ',', '.', '0', '1', '2', '3', //10..1f
   '4', '5', '6', '7', '8', '9', 'A', 'B', 'C', 'D', 'E', 'F', 'G', 'H', 'I', 'J', //20..2f
   'K', 'L', 'M', 'N', 'O', 'P', 'Q', 'R', 'S', 'T', 'U', 'V', 'W', 'X', 'Y', 'Z', //30..3f
   '?', '?', '?', '?', '?', '?', '?', '?', '?', '?', '?', '?', '?', '?', '?', '?', //40..4f
   '?', '?', '?', '?', '?', '?', '?', '?', '?', '?', '?', '?', '?', '?', '?', '?', //50..5f
   '?', '?', '?', '?', '?', '?', '?', '?', '?', '?', '?', '?', '?', '?', '?', '?', //60..6f
   '?', '?', '?', '?', '?', '?', '?', '?', '?', '?', '?', '?', '?', '?', '?', '?', //70..7f
   ' ', '?', '?', '?', '?', '?', '?', '?', '?', '?', '?', '"', '&', '$', ':', '?', //80..8f
   '(', ')', '>', '<', '=', '+', '-', '*', '/', ';', ',', '.', '0', '1', '2', '3', //90..9f
   '4', '5', '6', '7', '8', '9', 'A', 'B', 'C', 'D', 'E', 'F', 'G', 'H', 'I', 'J', //a0..af
   'K', 'L', 'M', 'N', 'O', 'P', 'Q', 'R', 'S', 'T', 'U', 'V', 'W', 'X', 'Y', 'Z', //b0..bf
  0x0f,0x0f,0x0f,0x0f,0x0f,0x0f,0x0f,0x0f,0x0f,0x0f,0x0f,0x0f,0x0f,0x0f,0x0f,0x0f, //c0..cf
  0x0f,0x0f,0x0f,0x0f,0x0f,0x0f,0x0f,0x0f,0x0f,0x0f,0x0f,0x0f,0x0f,0x0f,0x0f,' ', //d0..df
  0x0f,0x0f,0x0f,0x0f,0x0f,0x0f,0x0f,0x0f,0x0f,0x0f,0x0f,0x0f,0x0f,0x0f,0x0f,0x0f, //e0..ef
  0x0f,0x0f,0x0f,0x0f,0x0f,0x0f,0x0f,0x0f,0x0f,0x0f,0x0f,0x0f,0x0f,0x0f,0x0f,0x0f  //f0..ff
  }; 

void set_status_LED(uint8_t R,uint8_t G, uint8_t B){
#ifdef COMMON_ANODE
  analogWrite(ST_LED_R, 0xff-R); 
  analogWrite(ST_LED_G, 0xff-G); 
  analogWrite(ST_LED_B, 0xff-B); 
#else
  Serial.print("RED: "); Serial.println(R);
  Serial.print("GREEN: "); Serial.println(G);
  Serial.print("BLUE: "); Serial.println(B);
  analogWrite(ST_LED_R, R); 
  analogWrite(ST_LED_G, G); 
  analogWrite(ST_LED_B, B); 
#endif
}

void set_status_LED(uint32_t RGB){
  set_status_LED((RGB >> 16)&0xff, (RGB >> 8)&0xff, RGB & 0xff);
}

char current_dir[MAX_FILENAME_LEN] = "/";
char S[100];

void split_two_params(char* params, char* param1, char* param2){
  int i,j;
  for (i=0; params[i]!=' '; i++){
    if (params[i]!=0)
      param1[i]=params[i];
    else break;
  }
  param1[i]=0;
  if (params[i]!=0){
    i++;
    for (j=i;(params[j]!=0); j++){
      param2[j-i]=params[j];
    }
    param2[j-i]=0;
  } else param2[0]=0;
}

void hex_to_str(char* v, char* params){
  uint8_t i;
  uint8_t len = strlen(params);
  for (i=0; i<len/2;i++){
    sscanf(params, "%2hhx", v+i);
    params+=2;
  }
  v[i]=0;
}

void upStr(char* s){
  for (int i=0; s[i]!=0; i++){
    s[i] = toupper(s[i]);
  }
}

void log_0(const char* fmt, ...)
{
#ifdef LOG0
    va_list arg;
    va_start(arg, fmt);

    vsprintf(S,fmt, arg); 
    Serial.println(S);

    va_end(arg);
#endif
}

void log_1(const char* fmt, ...)
{
#ifdef LOG1
    va_list arg;
    va_start(arg, fmt);

    vsprintf(S,fmt, arg); 
    Serial.println(S);

    va_end(arg);
#endif
}

void log_2(const char* fmt, ...)
{
#ifdef LOG2
    va_list arg;
    va_start(arg, fmt);

    vsprintf(S,fmt, arg); 
    Serial.println(S);

    va_end(arg);
#endif
}

void log_3(const char* fmt, ...)
{
#ifdef LOG3
    va_list arg;
    va_start(arg, fmt);

    vsprintf(S,fmt, arg); 
    //vprintf can be replaced with vsprintf (for sprintf behavior) 
    //or any other printf function preceded by a v
    Serial.println(S);

    va_end(arg);
#endif
}

void start_reset_Z80(){
  digitalWrite(Z80_RESET, LOW);
  pinMode(Z80_RESET, OUTPUT);
  digitalWrite(Z80_RESET, LOW);
}

void end_reset_Z80(){
  pinMode(Z80_RESET, INPUT);
  digitalWrite(Z80_RESET, HIGH);
}
